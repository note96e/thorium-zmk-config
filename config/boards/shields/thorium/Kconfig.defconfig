## config/boards/shields/thorium/Kconfig.defconfig
```kconfig
if SHIELD_THORIUM

config ZMK_KEYBOARD_NAME
    default "Thorium"

config ZMK_SPLIT
    default y

config ZMK_SPLIT_ROLE_CENTRAL
    default y

endif

if SHIELD_THORIUM_LEFT

config ZMK_KEYBOARD_NAME
    default "ThoriumL"

config ZMK_SPLIT
    default y

endif

if SHIELD_THORIUM_RIGHT

config ZMK_KEYBOARD_NAME
    default "ThoriumR"

config ZMK_SPLIT
    default y

endif
```

## config/west.yml
```yaml
manifest:
  defaults:
    revision: v0.3
  remotes:
    - name: zmkfirmware
      url-base: https://github.com/zmkfirmware
    # Additional modules containing boards/shields/custom code can be listed here as well
    # See https://docs.zephyrproject.org/3.2.0/develop/west/manifest.html#projects
    - name: rschenk
      url-base: https://github.com/rschenk
  projects:
    - name: zmk
      remote: zmkfirmware
      revision: v0.3
#      revision: main
      import: app/west.yml
    - name: zmk-component-raytac-dongle
      remote: rschenk
      revision: v0.3
  self:
    path: config
```
